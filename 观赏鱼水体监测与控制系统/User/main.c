#include "stm32f10x.h"
#include "Delay.h"
#include "OLED.h"
#include "Temp.h"
#include "Pump.h"
#include "Turbidity.h"
#include "USART.h"

#include <string.h>
#include <stdio.h>


int main(void)
{
    float Temp;
    uint16_t Turbidity;
    uint8_t Pump;

    char Data[50];
    char Command[20];

    /*
       Mode = 0：手动模式
       Mode = 1：自动模式
    */
    uint8_t Mode = 0;


    /* =========================
       初始化
       ========================= */

    USART1_Init();

    OLED_Init();

    DS18B20_Init();

    Pump_Init();

    Turbidity_Init();


    /* =========================
       STM32准备完成
       ========================= */

    USART1_SendString("STM32 READY\r\n");


    /* =========================
       主循环
       ========================= */

    while(1)
    {

        /* ==================================================
           1. 检查 ESP8266 发来的命令
           ================================================== */

        if (USART1_GetCommand(Command))
        {

            /* ==============================================
               手动开启水泵
               ============================================== */

            if (strcmp(Command, "P=1") == 0)
            {
                /*
                   只有手动模式才能直接控制水泵
                */

                if (Mode == 0)
                {
                    Pump_ON();

                    USART1_SendString("PUMP ON\r\n");
                }
                else
                {
                    USART1_SendString("AUTO MODE\r\n");
                }
            }


            /* ==============================================
               手动关闭水泵
               ============================================== */

            else if (strcmp(Command, "P=0") == 0)
            {
                /*
                   只有手动模式才能直接控制水泵
                */

                if (Mode == 0)
                {
                    Pump_OFF();

                    USART1_SendString("PUMP OFF\r\n");
                }
                else
                {
                    USART1_SendString("AUTO MODE\r\n");
                }
            }


            /* ==============================================
               查询水泵状态
               ============================================== */

            else if (strcmp(Command, "P?") == 0)
            {
                if (Pump_GetState() == 1)
                {
                    USART1_SendString("PUMP ON\r\n");
                }
                else
                {
                    USART1_SendString("PUMP OFF\r\n");
                }
            }


            /* ==============================================
               切换自动模式
               ESP8266发送：MODE=1
               ============================================== */

            else if (strcmp(Command, "MODE=1") == 0)
            {
                Mode = 1;

                USART1_SendString("AUTO MODE\r\n");
            }


            /* ==============================================
               切换手动模式
               ESP8266发送：MODE=0
               ============================================== */

            else if (strcmp(Command, "MODE=0") == 0)
            {
                Mode = 0;

                USART1_SendString("MANUAL MODE\r\n");
            }
        }


        /* ==================================================
           2. 读取温度
           ================================================== */

        Temp = DS18B20_GetTemp();


        /* ==================================================
           3. 读取浊度
           ================================================== */

        Turbidity = Turbidity_GetValue();


        /* ==================================================
           4. 自动模式
           ================================================== */

        if (Mode == 1)
        {

            /*
               自动控制条件

               温度 > 30℃
               或
               浊度 < 1500

               水泵开启
            */

            if (Temp > 30 || Turbidity < 1500)
            {
                Pump_ON();
            }
            else
            {
                Pump_OFF();
            }
        }


        /* ==================================================
           5. 获取当前水泵状态
           ================================================== */

        Pump = Pump_GetState();


        /* ==================================================
           6. OLED显示温度
           ================================================== */

        OLED_ShowString(1, 1, "Temp:");

        OLED_ShowNum(
            1,
            6,
            (uint16_t)Temp,
            2
        );

        OLED_ShowChar(1, 8, '.');

        OLED_ShowNum(
            1,
            9,
            (uint16_t)(Temp * 100) % 100,
            2
        );


        /* ==================================================
           7. OLED显示浊度
           ================================================== */

        OLED_ShowString(2, 1, "Turb:");

        OLED_ShowNum(
            2,
            6,
            Turbidity,
            4
        );


        /* ==================================================
           8. OLED显示水泵状态
           ================================================== */

        OLED_ShowString(3, 1, "Pump:");

        if (Pump == 1)
        {
            OLED_ShowString(3, 6, "ON ");
        }
        else
        {
            OLED_ShowString(3, 6, "OFF");
        }


        /* ==================================================
           9. OLED显示模式
           ================================================== */

        OLED_ShowString(4, 1, "Mode:");

        if (Mode == 0)
        {
            OLED_ShowString(4, 6, "MANUAL");
        }
        else
        {
            OLED_ShowString(4, 6, "AUTO  ");
        }


        /* ==================================================
           10. 向ESP8266发送数据
           ================================================== */

        sprintf(
            Data,
            "T=%.1f,TU=%d,P=%d,M=%d\r\n",
            Temp,
            Turbidity,
            Pump,
            Mode
        );

        USART1_SendString(Data);


        /* ==================================================
           11. 主循环延时
           ================================================== */

        Delay_ms(1000);
    }
}